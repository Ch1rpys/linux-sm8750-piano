// SPDX-License-Identifier: BSD-3-Clause
/*
 * Supervised Bluetooth diagnostic variant of the piano board.
 *
 * Enables only the WCN7860 PMU (power sequencer), UART14 with its
 * Bluetooth child and the QUP2 wrapper that parents UART14. PCIe0 and the
 * WLAN function stay disabled. Not for default or unattended boots.
 */

#include "sm8750-xiaomi-piano.dts"

/*
 * The GENI SE nodes are children of the wrapper, and the wrapper is disabled
 * in sm8750.dtsi, so UART14 never probes without it. The GENI UART runs on the
 * SE's own FIFO/DMA engine and has no dmas property, so gpi_dma2 stays off.
 */
&qupv3_2 {
	status = "okay";
};

&uart14 {
	status = "okay";
};

&wcn7860_pmu {
	status = "okay";
};
