// SPDX-License-Identifier: BSD-3-Clause
/* Supervised Iris diagnostic. Load the existing module drivers after logging
 * is available; this variant does not enable the camera, GPU or DSPs.
 */

#include "sm8750-xiaomi-piano.dts"

&iris {
	firmware-name = "qcom/sm8750/piano/vpu35_4v.mbn";
	status = "okay";
};
